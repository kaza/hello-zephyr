## CMakeLists.txt
```
cmake_minimum_required(VERSION 3.20.0)

find_package(Zephyr REQUIRED HINTS $ENV{ZEPHYR_BASE})
project(esp32c6_blink)

target_sources(app PRIVATE src/main.c)
```

## prj.conf
```kconfig
# Enable GPIO driver
CONFIG_GPIO=y

# Console output
CONFIG_CONSOLE=y
CONFIG_UART_CONSOLE=y

# ESP32 specific
CONFIG_MAIN_STACK_SIZE=2048
```

## src/main.c
```c
#include <zephyr/kernel.h>

int main(void)
{
    int counter = 0;
    
    /* Super simple - just print numbers every second */
    while (1) {
        printk("TEST %d\n", counter);
        counter++;
        k_msleep(1000);
    }
    
    return 0;
}
```
