## prj.conf
```kconfig
# Minimal configuration for hello world
CONFIG_STDOUT_CONSOLE=y
CONFIG_CONSOLE=y
CONFIG_UART_CONSOLE=y

# Main thread stack size
CONFIG_MAIN_STACK_SIZE=1024
```

## src/main.c
```c
#include <zephyr/kernel.h>
#include <stdio.h>

int main(void)
{
    printf("=== Zebra'S ZEPHYR PROJECT ===\n");
    printf("Board: %s\n", CONFIG_BOARD);
    
    for (int i = 1; i <= 10; i++) {
        printf("[%d] Hello zebrasaurus! Time: %d seconds\n", 
               i, i * 2);
        k_sleep(K_SECONDS(2));
    }
    
    printf("Program finished! Total runtime: 20 seconds\n");
    
    return 0;
}
```
