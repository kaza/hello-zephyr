## CMakeLists.txt
```
# SPDX-License-Identifier: Apache-2.0

cmake_minimum_required(VERSION 3.20.0)

find_package(Zephyr REQUIRED HINTS $ENV{ZEPHYR_BASE})
project(hello_zephyr)

target_sources(app PRIVATE src/main.c)
```

## prj.conf
```kconfig
# Basic Zephyr configuration
CONFIG_STDOUT_CONSOLE=y
CONFIG_CONSOLE=y
CONFIG_UART_CONSOLE=y

# Enable logging
CONFIG_LOG=y
CONFIG_LOG_DEFAULT_LEVEL=3

# Main thread stack size
CONFIG_MAIN_STACK_SIZE=2048

# Enable shell (optional, useful for debugging)
# CONFIG_SHELL=y
```

## src/main.c
```c
#include <zephyr/kernel.h>
#include <zephyr/logging/log.h>

LOG_MODULE_REGISTER(main, LOG_LEVEL_INF);

int main(void)
{
    LOG_INF("Hello Zephyr! Starting application...");
    
    printk("Hello World from Zephyr RTOS!\n");
    printk("Board: %s\n", CONFIG_BOARD);
    
    int counter = 0;
    
    while (1) {
        LOG_INF("Counter: %d", counter++);
        k_msleep(1000);
    }
    
    return 0;
}
```
